## conf/machine/radxa-cm3-io-rk3566.conf
```bitbake
#@TYPE: Machine
#@NAME: Radxa-CM3-IO machine
#@DESCRIPTION: Radxa-CM3-IO development board config file

SOC_FAMILY = "rk3566"

DEFAULTTUNE ?= "cortexa55"
require conf/machine/include/arm/armv8-2a/tune-cortexa55.inc

require conf/machine/include/arm/arch-armv8a.inc
require conf/machine/include/soc-family.inc


PREFERRED_PROVIDER_virtual/kernel = "linux-radxa-cm3-io"
PREFERRED_VERSION_linux-rockchip = "4.19"

SERIAL_CONSOLES = "1500000;ttyS2"
KERNEL_IMAGETYPE = "Image"
KBUILD_DEFCONFIG = "rockchip_linux_defconfig"

PREFERRED_PROVIDER_virtual/bootloader ?= "u-boot-radxa-cm3-io"
PREFERRED_PROVIDER_u-boot = "u-boot-radxa-cm3-io"

KERNEL_DEVICETREE = "rockchip/rk3566-radxa-cm3-io.dtb"
UBOOT_MACHINE = "radxa-cm3-io-rk3566_defconfig"

MACHINE_ESSENTIAL_EXTRA_RRECOMMENDS += "\
    kernel-modules \
    resize-helper \
"

IMAGE_FSTYPES += "rockchip-radxa-gpt-img"
IMAGE_CLASSES += "rockchip-radxa-gpt-img"
IMAGE_ROOTFS_SIZE = "8192"
```
